## boards/shields/hifumil/Kconfig.defconfig
```kconfig
if SHIELD_HIFUMIL

config ZMK_KEYBOARD_NAME
    default "Hifumil-kf"

endif

if SHIELD_CYBER_ANGEL

config ZMK_KEYBOARD_NAME
    default "Cyb3rAng3l-kf"

endif
```

## boards/shields/hifumil/Kconfig.shield
```kconfig
config SHIELD_HIFUMIL
    def_bool $(shields_list_contains,hifumil)

config SHIELD_CYBER_ANGEL
    def_bool $(shields_list_contains,cyb3r_ang3l)
```
